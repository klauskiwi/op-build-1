## openpower/package/alternate-binutils/Config.in
```kconfig
config BR2_PACKAGE_ALTERNATE_BINUTILS
	bool "alternate-binutils"
	default y if BR2_PACKAGE_ALTERNATE_TOOLCHAIN_INTERNAL
	select BR2_CPP
	help
	  Build Binutils for an Alternate Toolchain, for use in
	  certain packages

if BR2_PACKAGE_ALTERNATE_BINUTILS

config BR2_ALTERNATE_BINUTILS_VERSION
	string "Alternate Toolchain Binutils Version"
	default "2.31.1"

endif
```

## openpower/package/alternate-gcc/Config.in
```kconfig
config BR2_PACKAGE_ALTERNATE_GCC
	bool "alternate-gcc"
	default y if BR2_PACKAGE_ALTERNATE_TOOLCHAIN_INTERNAL

	select BR2_PACKAGE_ALTERNATE_BINUTILS
	help
	  Build gcc for an Alternate Toolchain, for use in
	  certain packages.

if BR2_PACKAGE_ALTERNATE_GCC

config BR2_ALTERNATE_GCC_VERSION
	string "Alternate gcc version"
	default "6.5.0"

endif
```

## openpower/package/alternate-toolchain-external/Config.in
```kconfig
config BR2_PACKAGE_ALTERNATE_TOOLCHAIN_EXTERNAL
	bool "alternate-toolchain-external"
	select BR2_PACKAGE_HAS_ALTERNATE_TOOLCHAIN
	help
	  Use an external Alternate Toolchain

if BR2_PACKAGE_ALTERNATE_TOOLCHAIN_EXTERNAL
config BR2_PACKAGE_PROVIDES_ALTERNATE_TOOLCHAIN
	default "alternate-toolchain-external"

config BR2_ALTERNATE_TOOLCHAIN_EXTERNAL_PATH
	string "External Alternate Toolchain path"
	help
	  Pathname to where the external Alternate Toolchain
	  is installed. The toolchain is expected to be
	  fully contained within the
	  "alternate-toolchain/" sub-directory
endif
```

## openpower/package/alternate-toolchain-internal/Config.in
```kconfig
config BR2_PACKAGE_ALTERNATE_TOOLCHAIN_INTERNAL
	bool "alternate-toolchain-internal"
	select BR2_PACKAGE_HAS_ALTERNATE_TOOLCHAIN
	help
	  Build an Alternate Toolchain to be used by certain
	  packages versus the default buildtoot toolchain

if BR2_PACKAGE_ALTERNATE_TOOLCHAIN_INTERNAL
config BR2_PACKAGE_PROVIDES_ALTERNATE_TOOLCHAIN
	default "alternate-toolchain-internal"

source "$BR2_EXTERNAL_OP_BUILD_PATH/package/alternate-binutils/Config.in"
source "$BR2_EXTERNAL_OP_BUILD_PATH/package/alternate-gcc/Config.in"

endif
```

## openpower/toolchain/alternate-toolchain/Config.in
```kconfig
menuconfig BR2_PACKAGE_ALTERNATE_TOOLCHAIN
	bool "alternate-toolchain"
	help
	  Use an Alternate Toolchain to be used by certain
	  packages versus the default buildtoot toolchain

if BR2_PACKAGE_ALTERNATE_TOOLCHAIN
choice
	prompt "Alternate Toolchain Type"
	help
	  Select the type of the Alternate Toolchain to use

source "$BR2_EXTERNAL_OP_BUILD_PATH/package/alternate-toolchain-internal/Config.in"

endchoice

config BR2_PACKAGE_HAS_ALTERNATE_TOOLCHAIN
	bool

config BR2_PACKAGE_PROVIDES_ALTERNATE_TOOLCHAIN
	depends on BR2_PACKAGE_HAS_ALTERNATE_TOOLCHAIN
	string

endif
```
